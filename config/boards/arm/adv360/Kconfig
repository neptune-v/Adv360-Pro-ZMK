## config/boards/arm/adv360/Kconfig
```kconfig
# SPDX-License-Identifier: MIT
CONFIG_ZMK_USB_LOGGING=y
CONFIG_LOG_PROCESS_THREAD_STARTUP_DELAY_MS=16000
config BOARD_ENABLE_DCDC
    bool "Enable DCDC mode"
    select SOC_DCDC_NRF52X
    default y
    depends on BOARD_ADV360_LEFT || BOARD_ADV360_RIGHT
```
